## conf/distro/nxp-imx-kodi-fb.conf
```bitbake
# i.MX DISTRO for the XBMC FrameBuffer graphical backend.

include conf/distro/include/fsl-imx-base.inc
include conf/distro/include/fsl-imx-preferred-env.inc

DISTRO = "nxp-imx-kodi-fb"
PREFERRED_PROVIDER_xbmc = "kodi-imx"

DISTRO_FEATURES_append = " pam"

# Remove conflicting backends.
DISTRO_FEATURES_remove = "x11 wayland directfb "
```

## conf/distro/nxp-imx-xbmc-fb.conf
```bitbake
# i.MX DISTRO for the XBMC FrameBuffer graphical backend.

include conf/distro/include/fsl-imx-base.inc
include conf/distro/include/fsl-imx-preferred-env.inc

DISTRO = "nxp-imx-xbmc-fb"
PREFERRED_PROVIDER_xbmc = "xbmc"


# Remove conflicting backends.
DISTRO_FEATURES_remove = "x11 wayland directfb "
```

## conf/layer.conf
```bitbake
# We have a conf and classes directory, add to BBPATH
BBPATH .= ":${LAYERDIR}"

# We have a packages directory, add to BBFILES
BBFILES += "${LAYERDIR}/recipes-*/*/*.bb \
            ${LAYERDIR}/recipes-*/*/*.bbappend"

BBFILE_COLLECTIONS += "meta-nxp-xbmc"
BBFILE_PATTERN_meta-nxp-xbmc := "^${LAYERDIR}"
BBFILE_PRIORITY_meta-nxp-xbmc = "8"

LAYERSERIES_COMPAT_meta-nxp-xbmc = "thud warrior"
# Let us add layer-specific bbappends which are only applied when that
# layer is included in our configuration
BBFILES += "${@' '.join('${LAYERDIR}/%s/recipes*/*/*.bbappend' % layer \
               for layer in BBFILE_COLLECTIONS.split())}"
```
